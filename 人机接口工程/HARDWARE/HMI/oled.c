/* OLED模块：实现SSD1306页缓冲、5x7 ASCII字库和数值格式化显示。 */
#include "oled.h"
#include "hmi_port.h"
#include <string.h>
static uint8_t framebuffer[8][128];
static uint8_t ready;
/* 原创5x7点阵；ASCII 32~126；每字符加1列间距。 */
static const uint8_t font5x7[95][5]={
    {0x00,0x00,0x00,0x00,0x00}, /* ASCII 32 */
    {0x00,0x00,0x5F,0x00,0x00}, /* ASCII 33 */
    {0x00,0x07,0x00,0x07,0x00}, /* ASCII 34 */
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    {0x08,0x04,0x08,0x08,0x04}, /* ASCII 126 */
};
/**
 * 功能：将uint32转换为十进制字符
 * 参数：value：无符号值；text：至少11字节缓冲
 * 返回：字符数，不含结束零
 * 注意：内部使用，不调用printf
 * 作者/责任成员：吕朋聪；版本/日期：V1.0 / 2026-10-09。
 * 修改历史：2026-10-09，V1.0，首次实现 format_uint。
 */
static uint8_t format_uint(uint32_t value, char *text)
{
    char reverse[10]; uint8_t n=0,i;
    do { reverse[n++]=(char)('0'+value%10U); value/=10U; } while (value);
    for (i=0;i<n;++i) text[i]=reverse[n-1U-i];
    text[n]='\0'; return n;
}
/**
 * 功能：初始化SSD1306并清空屏幕
 * 参数：无
 * 返回：OLED_OK或OLED_IO_ERROR
 * 注意：调用前系统时钟已就绪；配置为128x64、0x3C、模块内置电荷泵
 * 作者/责任成员：吕朋聪；版本/日期：V1.0 / 2026-10-09。
 * 修改历史：2026-10-09，V1.0，首次实现 OLED_Init。
 */
oled_status_t OLED_Init(void)
{
    static const uint8_t config[]={
        0xAE,0xD5,0x80,0xA8,0x3F,0xD3,0x00,0x40,
        0x8D,0x14,0x20,0x02,0xA1,0xC8,0xDA,0x12,
        0x81,0x7F,0xD9,0xF1,0xDB,0x40,0xA4,0xA6,0x2E
    };
    const uint8_t on=0xAF;
    ready=0; HMI_PortInit(); HMI_DelayMs(100);
    if (HMI_OLEDWrite(0x00,config,sizeof(config))!=0)
        return OLED_IO_ERROR;
    ready=1; (void)OLED_Clear();
    if (OLED_Refresh()!=OLED_OK || HMI_OLEDWrite(0x00,&on,1)!=0) {
        ready=0; return OLED_IO_ERROR;
    }
    return OLED_OK;
}
/**
 * 功能：清空本地显示缓冲区
 * 参数：无
 * 返回：OLED_OK或OLED_NOT_READY
 * 注意：调用OLED_Refresh后实际屏幕才更新
 * 作者/责任成员：吕朋聪；版本/日期：V1.0 / 2026-10-09。
 * 修改历史：2026-10-09，V1.0，首次实现 OLED_Clear。
 */
oled_status_t OLED_Clear(void)
{
    if (!ready) return OLED_NOT_READY;
    memset(framebuffer,0,sizeof(framebuffer)); return OLED_OK;
}
/**
 * 功能：将1024字节缓冲区按8页写入屏幕
 * 参数：无
 * 返回：OLED_OK/OLED_IO_ERROR/OLED_NOT_READY
 * 注意：阻塞通信，仅主循环调用；失败时可重试或重新初始化
 * 作者/责任成员：吕朋聪；版本/日期：V1.0 / 2026-10-09。
 * 修改历史：2026-10-09，V1.0，首次实现 OLED_Refresh。
 */
oled_status_t OLED_Refresh(void)
{
    uint8_t p;
    if (!ready) return OLED_NOT_READY;
    for (p=0;p<8;++p) {
        uint8_t position[3]={(uint8_t)(0xB0U+p),0x00,0x10};
        if (HMI_OLEDWrite(0x00,position,3)!=0 ||
            HMI_OLEDWrite(0x40,framebuffer[p],128)!=0)
            return OLED_IO_ERROR;
    }
    return OLED_OK;
}
/**
 * 功能：在缓冲区显示一个5x7字符，含1列间距
 * 参数：x：0~122像素；page：0~7；ch：ASCII字符
 * 返回：OLED_OK/OLED_BAD_ARG/OLED_NOT_READY
 * 注意：只修改缓冲；不可显示字符替换为问号；再调用Refresh
 * 作者/责任成员：吕朋聪；版本/日期：V1.0 / 2026-10-09。
 * 修改历史：2026-10-09，V1.0，首次实现 OLED_ShowChar。
 */
oled_status_t OLED_ShowChar(uint8_t x, uint8_t page, char ch)
{
    uint8_t code=(uint8_t)ch;
    if (!ready) return OLED_NOT_READY;
    if (x>122 || page>7) return OLED_BAD_ARG;
    if (code<32 || code>126) code='?';
    memcpy(&framebuffer[page][x],font5x7[code-32U],5);
    framebuffer[page][x+5U]=0; return OLED_OK;
}
/**
 * 功能：在缓冲区显示单行字符串
 * 参数：x：起始像素；page：页0~7；text：以零结束的字符串
 * 返回：OLED_OK/OLED_BAD_ARG/OLED_NOT_READY
 * 注意：超出本行返回错误且不写入；不自动换行；更新后Refresh
 * 作者/责任成员：吕朋聪；版本/日期：V1.0 / 2026-10-09。
 * 修改历史：2026-10-09，V1.0，首次实现 OLED_ShowString。
 */
oled_status_t OLED_ShowString(uint8_t x, uint8_t page, const char *text)
{
    uint8_t n=0,i,capacity;
    if (!ready) return OLED_NOT_READY;
    if (text==0 || page>7 || x>122) return OLED_BAD_ARG;
    capacity=(uint8_t)((128U-x)/6U);
    while (text[n]!=0) {
        if (n>=capacity) return OLED_BAD_ARG;
        ++n;
    }
    for (i=0;i<n;++i) (void)OLED_ShowChar((uint8_t)(x+i*6U),page,text[i]);
    return OLED_OK;
}
/**
 * 功能：显示有符号32位十进制整数
 * 参数：x/page：坐标；value：整数，含INT32_MIN
 * 返回：OLED_OK/OLED_BAD_ARG/OLED_NOT_READY
 * 注意：不补前导零；覆盖旧数值前清屏或用空格填充；再Refresh
 * 作者/责任成员：吕朋聪；版本/日期：V1.0 / 2026-10-09。
 * 修改历史：2026-10-09，V1.0，首次实现 OLED_ShowInt。
 */
oled_status_t OLED_ShowInt(uint8_t x, uint8_t page, int32_t value)
{
    char text[12]; uint8_t offset=0; uint32_t magnitude;
    if (value<0) { text[offset++]='-'; magnitude=(uint32_t)(-(value+1))+1U; }
    else magnitude=(uint32_t)value;
    (void)format_uint(magnitude,text+offset);
    return OLED_ShowString(x,page,text);
}
/**
 * 功能：显示定点格式浮点数，四舍五入
 * 参数：x/page：坐标；value：数值；decimals：0~6小数位
 * 返回：OLED_OK/OLED_BAD_ARG/OLED_NOT_READY
 * 注意：拒绝NaN/无穷和放大后超出uint32范围的值；舍入半值远离零；再Refresh
 * 作者/责任成员：吕朋聪；版本/日期：V1.0 / 2026-10-09。
 * 修改历史：2026-10-09，V1.0，首次实现 OLED_ShowFloat。
 */
oled_status_t OLED_ShowFloat(uint8_t x, uint8_t page, double value, uint8_t decimals)
{
    char text[24]; uint32_t scale=1,rounded,fraction;
    uint8_t i,n=0; double magnitude=value;
    if (decimals>6 || value!=value) return OLED_BAD_ARG;
    if (value<0) magnitude=-value;
    for (i=0;i<decimals;++i) scale*=10U;
    magnitude*=scale;
    if (!(magnitude<=4294967294.0)) return OLED_BAD_ARG;
    rounded=(uint32_t)(magnitude+0.5);
    if (value<0 && rounded!=0) text[n++]='-';
    n+=format_uint(rounded/scale,text+n);
    if (decimals) {
        text[n++]='.'; fraction=rounded%scale;
        for (i=0;i<decimals;++i) {
            scale/=10U; text[n++]=(char)('0'+fraction/scale); fraction%=scale;
        }
    }
    text[n]=0; return OLED_ShowString(x,page,text);
}
